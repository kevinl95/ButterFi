## CMakeLists.txt
```
cmake_minimum_required(VERSION 3.20.0)

set(BUTTERFI_USB_CONTROL_DEBUG_DEFAULT ON)
if(DEFINED ENV{BUTTERFI_USB_CONTROL_DEBUG})
    set(BUTTERFI_USB_CONTROL_DEBUG_DEFAULT $ENV{BUTTERFI_USB_CONTROL_DEBUG})
endif()

set(BUTTERFI_INCLUDE_SIDEWALK_DEFAULT OFF)
if(DEFINED ENV{BUTTERFI_INCLUDE_SIDEWALK})
    set(BUTTERFI_INCLUDE_SIDEWALK_DEFAULT $ENV{BUTTERFI_INCLUDE_SIDEWALK})
endif()

set(BUTTERFI_DISABLE_SIDEWALK_ASSERTS_DEFAULT OFF)
if(DEFINED ENV{BUTTERFI_DISABLE_SIDEWALK_ASSERTS})
    set(BUTTERFI_DISABLE_SIDEWALK_ASSERTS_DEFAULT $ENV{BUTTERFI_DISABLE_SIDEWALK_ASSERTS})
endif()

option(BUTTERFI_USB_CONTROL_DEBUG "Build the USB-only control runtime" ${BUTTERFI_USB_CONTROL_DEBUG_DEFAULT})
option(BUTTERFI_INCLUDE_SIDEWALK "Compile in the Sidewalk SDK and related sources" ${BUTTERFI_INCLUDE_SIDEWALK_DEFAULT})
option(BUTTERFI_DISABLE_SIDEWALK_ASSERTS "Compile the Sidewalk PAL with asserts disabled" ${BUTTERFI_DISABLE_SIDEWALK_ASSERTS_DEFAULT})

# Point at Amazon Sidewalk SDK before finding Zephyr
# Set SIDEWALK_BASE in your environment:
#   export SIDEWALK_BASE=$HOME/sidewalk
if(BUTTERFI_INCLUDE_SIDEWALK)
    list(APPEND ZEPHYR_EXTRA_MODULES $ENV{SIDEWALK_BASE})
endif()

find_package(Zephyr REQUIRED HINTS $ENV{BUTTERFI_ZEPHYR_BASE_HINT} $ENV{ZEPHYR_BASE})
project(butterfi VERSION 1.0.0)

if(BUTTERFI_DISABLE_SIDEWALK_ASSERTS)
    zephyr_compile_definitions(SID_PAL_ASSERT_DISABLED)
endif()

target_compile_definitions(app PRIVATE BUTTERFI_VERSION=\"${PROJECT_VERSION}\")

if(BUTTERFI_USB_CONTROL_DEBUG)
    target_compile_definitions(app PRIVATE BUTTERFI_USB_CONTROL_DEBUG=1)
else()
    target_compile_definitions(app PRIVATE BUTTERFI_USB_CONTROL_DEBUG=0)
endif()

if(BUTTERFI_INCLUDE_SIDEWALK)
    target_compile_definitions(app PRIVATE BUTTERFI_INCLUDE_SIDEWALK=1)
else()
    target_compile_definitions(app PRIVATE BUTTERFI_INCLUDE_SIDEWALK=0)
endif()

target_sources(app PRIVATE
    src/main.c
    src/butterfi_config.c
    src/butterfi_usb.c
)

target_include_directories(app PRIVATE src)
```

## Kconfig
```
# ButterFi application Kconfig.
#
# NOTE: because this app Kconfig exists, Zephyr uses it as the application's
# root Kconfig — it MUST `source "Kconfig.zephyr"` at the end or the entire
# Zephyr Kconfig tree disappears.

config BUTTERFI_LOG_CDC
	bool "Expose a second USB CDC ACM for console + LOG (field debug)"
	default n
	help
	  When enabled, app.overlay instantiates a second USB CDC ACM interface
	  (cdc_acm_uart1) and routes the Zephyr console + LOG backend to it, so
	  Sidewalk/Zephyr logs surface as a second /dev/ttyACM for field debugging
	  with no SWD probe.

	  Leave disabled (the default) for student units: the browser's Web Serial
	  device picker then shows exactly ONE device — the ButterFi runtime port —
	  so a young student cannot pick the wrong one. Enable it via
	  prj.sidewalk-log.conf, which also turns the console/UART LOG backend on.

source "Kconfig.zephyr"
```

## prj.conf
```kconfig
# ButterFi prj.conf
# nRF Connect SDK / Zephyr configuration

# ── Bluetooth disabled by default; Sidewalk builds override in overlay conf ─
CONFIG_BT=n

# ── USB CDC-ACM (provisioning serial interface) ─────────────────────────────
CONFIG_USB_DEVICE_STACK=y
CONFIG_USB_DEVICE_STACK_NEXT=n
CONFIG_USB_CDC_ACM=y
CONFIG_UART_LINE_CTRL=y
CONFIG_UART_INTERRUPT_DRIVEN=y
CONFIG_USB_DEVICE_MANUFACTURER="ButterFi"
CONFIG_USB_DEVICE_PRODUCT="ButterFi"
CONFIG_USB_DEVICE_PID=0x000A
CONFIG_CONSOLE=n
CONFIG_UART_CONSOLE=n
CONFIG_LOG_BACKEND_UART=n

# ── NVS (config storage) ────────────────────────────────────────────────────
CONFIG_NVS=y
CONFIG_FLASH=y
CONFIG_FLASH_MAP=y
CONFIG_FLASH_PAGE_LAYOUT=y
CONFIG_JSON_LIBRARY=y

# ── Logging ─────────────────────────────────────────────────────────────────
CONFIG_LOG=y
CONFIG_LOG_MODE_MINIMAL=y
CONFIG_LOG_DEFAULT_LEVEL=3
CONFIG_SERIAL=y

# ── System ──────────────────────────────────────────────────────────────────
CONFIG_REBOOT=y
CONFIG_MAIN_STACK_SIZE=4096
CONFIG_SYSTEM_WORKQUEUE_STACK_SIZE=2048
```

## prj.bt-debug.conf
```kconfig
# Bluetooth enabled, Sidewalk excluded, USB control runtime kept active.

CONFIG_BT=y
CONFIG_BT_PERIPHERAL=y
CONFIG_BT_DEVICE_NAME="ButterFi"
CONFIG_BT_DEVICE_NAME_DYNAMIC=n

CONFIG_USB_DEVICE_PRODUCT="ButterFi DBG12"
CONFIG_USB_DEVICE_PID=0x000C
```

## prj.sidewalk-debug-assert-core.conf
```kconfig
# Sidewalk/Bluetooth enabled for the USB control debug build with CONFIG_ASSERT enabled
# but assert-coupled secondary defaults forced back to the working values.

CONFIG_SIDEWALK=y
CONFIG_SIDEWALK_DFU=n
CONFIG_SIDEWALK_SUBGHZ_SUPPORT=n

CONFIG_BT=y
CONFIG_BT_PERIPHERAL=y
CONFIG_BT_DEVICE_NAME="ButterFi"
CONFIG_BT_DEVICE_NAME_DYNAMIC=n

CONFIG_ASSERT=y
CONFIG_MEM_SLAB_POINTER_VALIDATE=n
CONFIG_SYSTEM_WORKQUEUE_WORK_TIMEOUT_MS=0
CONFIG_LOG_PROCESS_THREAD_STACK_SIZE=768
CONFIG_LOG_BACKED_RPC_CRASH_INFO_FILENAME_SIZE=1

CONFIG_USB_DEVICE_PRODUCT="ButterFi DBG18"
CONFIG_USB_DEVICE_PID=0x0012
```

## prj.sidewalk-debug-assert-handler.conf
```kconfig
# Sidewalk/Bluetooth enabled for the USB control debug build with CONFIG_ASSERT
# enabled, secondary assert-coupled defaults forced to the known-good values,
# and a custom Bluetooth controller assert handler to capture the failing file/line.

CONFIG_SIDEWALK=y
CONFIG_SIDEWALK_DFU=n
CONFIG_SIDEWALK_SUBGHZ_SUPPORT=n

CONFIG_BT=y
CONFIG_BT_PERIPHERAL=y
CONFIG_BT_DEVICE_NAME="ButterFi"
CONFIG_BT_DEVICE_NAME_DYNAMIC=n
CONFIG_BT_CTLR_ASSERT_HANDLER=y

CONFIG_ASSERT=y
CONFIG_MEM_SLAB_POINTER_VALIDATE=n
CONFIG_SYSTEM_WORKQUEUE_WORK_TIMEOUT_MS=0
CONFIG_LOG_PROCESS_THREAD_STACK_SIZE=768
CONFIG_LOG_BACKED_RPC_CRASH_INFO_FILENAME_SIZE=1

CONFIG_USB_DEVICE_PRODUCT="ButterFi DBG19"
CONFIG_USB_DEVICE_PID=0x0013
```

## prj.sidewalk-debug-assert-persist.conf
```kconfig
# Sidewalk/Bluetooth enabled with CONFIG_ASSERT=y and controller/global assert
# capture persisted across reboot so USB can report the failure in safe mode.

CONFIG_SIDEWALK=y
CONFIG_SIDEWALK_DFU=n
CONFIG_SIDEWALK_SUBGHZ_SUPPORT=n

CONFIG_BT=y
CONFIG_BT_PERIPHERAL=y
CONFIG_BT_DEVICE_NAME="ButterFi"
CONFIG_BT_DEVICE_NAME_DYNAMIC=n
CONFIG_BT_CTLR_ASSERT_HANDLER=y

CONFIG_ASSERT=y
CONFIG_MEM_SLAB_POINTER_VALIDATE=n
CONFIG_SYSTEM_WORKQUEUE_WORK_TIMEOUT_MS=0
CONFIG_LOG_PROCESS_THREAD_STACK_SIZE=768
CONFIG_LOG_BACKED_RPC_CRASH_INFO_FILENAME_SIZE=1

CONFIG_USB_DEVICE_PRODUCT="ButterFi DBG20"
CONFIG_USB_DEVICE_PID=0x0014
```

## prj.sidewalk-debug-noassert.conf
```kconfig
# Sidewalk/Bluetooth enabled for the USB control debug build with asserts disabled.

CONFIG_SIDEWALK=y
CONFIG_SIDEWALK_DFU=n
CONFIG_SIDEWALK_SUBGHZ_SUPPORT=n

CONFIG_BT=y
CONFIG_BT_PERIPHERAL=y
CONFIG_BT_DEVICE_NAME="ButterFi"
CONFIG_BT_DEVICE_NAME_DYNAMIC=n

CONFIG_ASSERT=n

CONFIG_USB_DEVICE_PRODUCT="ButterFi DBG15"
CONFIG_USB_DEVICE_PID=0x000F
```

## prj.sidewalk-debug-nonblocking.conf
```kconfig
# Sidewalk/Bluetooth enabled for the USB control debug build.

CONFIG_SIDEWALK=y
CONFIG_SIDEWALK_DFU=n
CONFIG_SIDEWALK_SUBGHZ_SUPPORT=n

CONFIG_BT=y
CONFIG_BT_PERIPHERAL=y
CONFIG_BT_DEVICE_NAME="ButterFi"
CONFIG_BT_DEVICE_NAME_DYNAMIC=n

CONFIG_USB_DEVICE_PRODUCT="ButterFi DBG14"
CONFIG_USB_DEVICE_PID=0x000E
```

## app.overlay
```dts
/* Student build (default): expose ONLY the ButterFi runtime CDC
 * (board_cdc_acm_uart, from the board), so the browser's Web Serial picker
 * shows exactly one device — a young student cannot pick the wrong port. The
 * console + LOG go to the hardware uart0 (physical pins, no USB port). Note:
 * disabling the console/LOG entirely faults this board at boot, so we keep them
 * enabled but off the USB — see prj.sidewalk.conf for the why.
 *
 * Field-debug build (CONFIG_BUTTERFI_LOG_CDC=y, via prj.sidewalk-log.conf):
 * add a second USB CDC ACM (cdc_acm_uart1) and route the console + LOG backend
 * to it, so Sidewalk/Zephyr logs — including the disconnect reason — come out
 * as a second /dev/ttyACM with no adapter. Overlays are run through the C
 * preprocessor, so the CONFIG_* gate below is honored at build time.
 */
#if defined(CONFIG_BUTTERFI_LOG_CDC)
&zephyr_udc0 {
	cdc_acm_uart1: cdc_acm_uart1 {
		compatible = "zephyr,cdc-acm-uart";
	};
};
#endif

/ {
	chosen {
#if defined(CONFIG_BUTTERFI_LOG_CDC)
		zephyr,console = &cdc_acm_uart1;
#else
		/* Student: console + LOG on the hardware UART, off the USB entirely. */
		zephyr,console = &uart0;
#endif
		/* Keep these off the runtime CDC regardless of build variant so
		 * nothing but the ButterFi binary protocol ever writes to it. */
		/delete-property/ zephyr,shell-uart;
		/delete-property/ zephyr,uart-mcumgr;
		/delete-property/ zephyr,bt-mon-uart;
		/delete-property/ zephyr,bt-c2h-uart;
	};
};
```

## src/butterfi_config.c
```c
/*
 * butterfi_config.c
 */

#include <zephyr/logging/log.h>
#include <zephyr/drivers/flash.h>
#include <zephyr/fs/nvs.h>
#include <zephyr/storage/flash_map.h>
#include <pm_config.h>
#include <string.h>
#include "butterfi_config.h"

LOG_MODULE_REGISTER(butterfi_config, LOG_LEVEL_INF);

static struct nvs_fs fs;
static butterfi_config_t active_config;
static bool nvs_ready;   /* true once nvs_mount() has succeeded */

int butterfi_config_load(void)
{
    int ret;
    struct flash_pages_info info;
    const struct flash_area *fa;

    /* Mount NVS on the dedicated butterfi_storage partition (Partition
     * Manager), NOT the DTS storage_partition — the latter overlaps
     * settings_storage, where Sidewalk keeps its registration/time-sync key
     * store, and this NVS instance would corrupt it on mount. */
    ret = flash_area_open(PM_BUTTERFI_STORAGE_ID, &fa);
    if (ret < 0) {
        LOG_ERR("Open butterfi_storage failed: %d", ret);
        return ret;
    }
    fs.flash_device = flash_area_get_device(fa);
    fs.offset       = fa->fa_off;
    flash_area_close(fa);

    ret = flash_get_page_info_by_offs(fs.flash_device, fs.offset, &info);
    if (ret < 0) {
        LOG_ERR("Flash page info failed: %d", ret);
        return ret;
    }

    fs.sector_size  = info.size;
    fs.sector_count = 3U;

    ret = nvs_mount(&fs);
    if (ret < 0) {
        LOG_ERR("NVS mount failed: %d", ret);
        return ret;
    }
    nvs_ready = true;

    /* Read each field — if any are missing, treat as unprovisioned */
    ssize_t len;

    len = nvs_read(&fs, NVS_ID_SCHOOL_ID,
                   active_config.school_id,
                   sizeof(active_config.school_id));
    if (len <= 0) {
        LOG_WRN("school_id not found in NVS");
        return -ENOENT;
    }

    len = nvs_read(&fs, NVS_ID_DEVICE_NAME,
                   active_config.device_name,
                   sizeof(active_config.device_name));
    if (len <= 0) {
        strncpy(active_config.device_name, "ButterFi-Dongle",
                sizeof(active_config.device_name));
    }

    len = nvs_read(&fs, NVS_ID_CONTENT_PKG,
                   active_config.content_pkg,
                   sizeof(active_config.content_pkg));
    if (len <= 0) {
        strncpy(active_config.content_pkg, "k12-general",
                sizeof(active_config.content_pkg));
    }

    /* Optional: teacher contact email for the contact-teacher feature. Empty
     * if the dongle was provisioned without one. */
    len = nvs_read(&fs, NVS_ID_TEACHER_EMAIL,
                   active_config.teacher_email,
                   sizeof(active_config.teacher_email));
    if (len <= 0) {
        active_config.teacher_email[0] = '\0';
    }

    uint8_t prov = 0;
    nvs_read(&fs, NVS_ID_PROVISIONED, &prov, sizeof(prov));
    active_config.provisioned = (prov == 1);

    LOG_INF("Config loaded OK");
    return 0;
}

int butterfi_config_save(const butterfi_config_t *cfg)
{
    int ret;

    ret = nvs_write(&fs, NVS_ID_SCHOOL_ID,
                    cfg->school_id,
                    strnlen(cfg->school_id, BUTTERFI_SCHOOL_ID_MAX) + 1);
    if (ret < 0) { LOG_ERR("NVS write school_id failed: %d", ret); return ret; }

    ret = nvs_write(&fs, NVS_ID_DEVICE_NAME,
                    cfg->device_name,
                    strnlen(cfg->device_name, BUTTERFI_DEVICE_NAME_MAX) + 1);
    if (ret < 0) { LOG_ERR("NVS write device_name failed: %d", ret); return ret; }

    ret = nvs_write(&fs, NVS_ID_CONTENT_PKG,
                    cfg->content_pkg,
                    strnlen(cfg->content_pkg, BUTTERFI_CONTENT_PKG_MAX) + 1);
    if (ret < 0) { LOG_ERR("NVS write content_pkg failed: %d", ret); return ret; }

    ret = nvs_write(&fs, NVS_ID_TEACHER_EMAIL,
                    cfg->teacher_email,
                    strnlen(cfg->teacher_email, BUTTERFI_TEACHER_EMAIL_MAX) + 1);
    if (ret < 0) { LOG_ERR("NVS write teacher_email failed: %d", ret); return ret; }

    uint8_t prov = 1;
    ret = nvs_write(&fs, NVS_ID_PROVISIONED, &prov, sizeof(prov));
    if (ret < 0) { LOG_ERR("NVS write provisioned failed: %d", ret); return ret; }

    memcpy(&active_config, cfg, sizeof(butterfi_config_t));
    active_config.provisioned = true;

    LOG_INF("Config saved: school=%s pkg=%s",
            active_config.school_id, active_config.content_pkg);
    return 0;
}

void butterfi_config_clear(void)
{
    /* nvs_clear() erases the whole butterfi_storage partition, including
     * NVS_ID_MAINT_GEN — so a Sidewalk factory reset (the only caller) re-arms
     * the one-time settings_storage wipe on the next boot. That is intentional:
     * a factory reset should also drop any stale maintenance state. nvs_clear()
     * also leaves fs unmounted, so writes fail until reboot — the caller
     * (on_factory_reset) sys_reboot()s immediately, so that is fine today. */
    nvs_clear(&fs);
    nvs_ready = false;
    memset(&active_config, 0, sizeof(active_config));
    LOG_WRN("Config cleared");
}

int butterfi_config_get_maint_gen(uint32_t *gen)
{
    ssize_t len;

    if (gen == NULL) {
        return -EINVAL;
    }

    /* Fail closed: if NVS never mounted, an unmounted nvs_read returns
     * -EACCES, and reporting gen=0 here would run the (unrecordable)
     * maintenance wipe on every boot forever. Return the error instead so the
     * caller skips the wipe. */
    if (!nvs_ready) {
        return -EIO;
    }

    *gen = 0;
    len = nvs_read(&fs, NVS_ID_MAINT_GEN, gen, sizeof(*gen));
    if (len == -ENOENT) {
        *gen = 0;   /* never written yet — a legitimate 0 */
        return 0;
    }
    if (len != (ssize_t)sizeof(*gen)) {
        return (len < 0) ? (int)len : -EIO;
    }
    return 0;
}

int butterfi_config_set_maint_gen(uint32_t gen)
{
    int ret;

    if (!nvs_ready) {
        return -EIO;
    }

    ret = nvs_write(&fs, NVS_ID_MAINT_GEN, &gen, sizeof(gen));
    return (ret < 0) ? ret : 0;
}

const char *butterfi_config_get_school_id(void)   { return active_config.school_id; }
const char *butterfi_config_get_device_name(void) { return active_config.device_name; }
const char *butterfi_config_get_content_pkg(void) { return active_config.content_pkg; }
const char *butterfi_config_get_teacher_email(void) { return active_config.teacher_email; }
bool        butterfi_config_is_provisioned(void)  { return active_config.provisioned; }
```

## src/butterfi_config.h
```c
/*
 * butterfi_config.h
 *
 * NVS-backed device configuration.
 * Values are written by the web provisioning tool over USB CDC,
 * and read at boot to configure Sidewalk and content selection.
 */

#ifndef BUTTERFI_CONFIG_H
#define BUTTERFI_CONFIG_H

#include <zephyr/kernel.h>

/* NVS key IDs */
#define NVS_ID_SCHOOL_ID     1
#define NVS_ID_DEVICE_NAME   2
#define NVS_ID_CONTENT_PKG   3
#define NVS_ID_PROVISIONED   4   /* u8: 0=no, 1=yes */
#define NVS_ID_MAINT_GEN     5   /* u32: one-time-maintenance generation */

#define BUTTERFI_SCHOOL_ID_MAX   32
#define BUTTERFI_DEVICE_NAME_MAX 48
#define BUTTERFI_CONTENT_PKG_MAX 24

typedef struct {
    char school_id[BUTTERFI_SCHOOL_ID_MAX];
    char device_name[BUTTERFI_DEVICE_NAME_MAX];
    char content_pkg[BUTTERFI_CONTENT_PKG_MAX];
    bool provisioned;
} butterfi_config_t;

/**
 * Load config from NVS flash storage.
 * Returns 0 on success, -ENOENT if not yet provisioned.
 */
int butterfi_config_load(void);

/**
 * Write a new config to NVS. Called by the USB provisioning handler.
 */
int butterfi_config_save(const butterfi_config_t *cfg);

/**
 * Erase all stored config (factory reset).
 */
void butterfi_config_clear(void);

/**
 * Read/write the one-time-maintenance generation marker. Used to run a
 * migration step (e.g. wiping a flash region) exactly once per firmware that
 * bumps the generation. Returns 0 on success. get sets *gen to 0 if unset.
 */
int butterfi_config_get_maint_gen(uint32_t *gen);
int butterfi_config_set_maint_gen(uint32_t gen);

const char *butterfi_config_get_school_id(void);
const char *butterfi_config_get_device_name(void);
const char *butterfi_config_get_content_pkg(void);
bool        butterfi_config_is_provisioned(void);

#endif /* BUTTERFI_CONFIG_H */
```

## src/butterfi_content.c
```c
/*
 * Placeholder content handler for the XIAO firmware.
 *
 * The cloud stack currently expects the binary ButterFi request/resend
 * protocol described in docs/shared-protocol.md. The moved XIAO scaffold does
 * not implement that contract yet, so this file intentionally logs the gap
 * instead of pretending the end-to-end runtime path exists.
 */

#include <zephyr/logging/log.h>

#include "butterfi_content.h"

LOG_MODULE_REGISTER(butterfi_content, LOG_LEVEL_INF);

void butterfi_content_handle_msg(const struct sid_msg_desc *desc,
                                 const struct sid_msg *msg)
{
    ARG_UNUSED(desc);
    ARG_UNUSED(msg);

    LOG_WRN("XIAO Sidewalk message received, but the ButterFi chunk/resend runtime path is not implemented yet");
}
```

## src/butterfi_content.h
```c
/*
 * butterfi_content.h
 *
 * Content routing module.
 *
 * Receives Sidewalk messages and responds with educational content
 * appropriate for the configured content package.
 *
 * In v1 this is intentionally minimal — the "content" is metadata
 * (URLs, resource lists) that the student's PWA resolves from the
 * cached bundle. The dongle doesn't serve files itself; it just
 * provides authenticated Sidewalk connectivity and config.
 */

#ifndef BUTTERFI_CONTENT_H
#define BUTTERFI_CONTENT_H

#if BUTTERFI_INCLUDE_SIDEWALK
#include <sid_api.h>

/**
 * Called by main when a Sidewalk message arrives.
 * Parses the request type and queues a response via sid_put_msg.
 */
void butterfi_content_handle_msg(const struct sid_msg_desc *desc,
                                  const struct sid_msg *msg);
#endif

#endif /* BUTTERFI_CONTENT_H */
```

## src/butterfi_usb.c
```c
#include <zephyr/device.h>
#include <zephyr/kernel.h>
#include <zephyr/logging/log.h>
#include <zephyr/drivers/uart.h>
#include <zephyr/sys/ring_buffer.h>
#include <zephyr/usb/usb_device.h>
#include <string.h>

#include "butterfi_usb.h"

LOG_MODULE_REGISTER(butterfi_usb, LOG_LEVEL_INF);

#define BUTTERFI_USB_SYNC_1 0x42
#define BUTTERFI_USB_SYNC_2 0x46
#define BUTTERFI_USB_VERSION 0x01
#define BUTTERFI_USB_HEADER_SIZE 8
#define BUTTERFI_USB_MAX_PAYLOAD 512
#define BUTTERFI_USB_MAX_FRAME_SIZE (BUTTERFI_USB_HEADER_SIZE + BUTTERFI_USB_MAX_PAYLOAD + 1)
#define BUTTERFI_USB_RX_RING_SIZE 1024
#define BUTTERFI_USB_TX_RING_SIZE 1024

static const struct device *const cdc_dev = DEVICE_DT_GET(DT_NODELABEL(board_cdc_acm_uart));
static butterfi_usb_host_frame_handler_t host_frame_handler;
static void *host_frame_context;

static struct {
    uint8_t device_state;
    uint8_t link_state;
    uint8_t active_request_id;
} cached_status = {
    .device_state = BUTTERFI_USB_DEVICE_STATE_IDLE,
    .link_state = BUTTERFI_USB_LINK_UNKNOWN,
    .active_request_id = 0,
};

static uint8_t rx_frame[BUTTERFI_USB_MAX_FRAME_SIZE];
static size_t rx_frame_len;
static size_t expected_frame_len;
static bool last_dtr_asserted;
static bool host_session_active;
static bool rx_throttled;
static uint8_t rx_ring_buffer[BUTTERFI_USB_RX_RING_SIZE];
static struct ring_buf rx_ring;
static uint8_t tx_ring_buffer[BUTTERFI_USB_TX_RING_SIZE];
static struct ring_buf tx_ring;
/* Zephyr ring_buf is single-producer/single-consumer, but frames are queued
 * from multiple threads (the main/sid_process thread emits status + debug
 * telemetry via the Sidewalk callbacks, the USB thread emits periodic status
 * and boot info). Serialize every producer so frames can't interleave — this
 * is the channel the whole diagnostic picture is read from. */
static K_MUTEX_DEFINE(tx_mutex);
static struct butterfi_usb_diag_counters usb_diag = {
    .last_tx_result = 0,
    .last_frame_type = 0,
};

static void parse_byte(uint8_t byte);

static bool host_ready_for_tx(void)
{
    return last_dtr_asserted || host_session_active;
}

static uint8_t frame_checksum(const uint8_t *frame, size_t frame_len)
{
    uint8_t checksum = 0;

    for (size_t index = 2; index + 1 < frame_len; index++) {
        checksum ^= frame[index];
    }

    return checksum;
}

static void parser_reset(void)
{
    rx_frame_len = 0;
    expected_frame_len = 0;
}

static void cdc_interrupt_handler(const struct device *dev, void *user_data)
{
    ARG_UNUSED(user_data);

    while (uart_irq_update(dev) && uart_irq_is_pending(dev)) {
        if (!rx_throttled && uart_irq_rx_ready(dev)) {
            uint8_t buffer[64];
            size_t len = MIN(ring_buf_space_get(&rx_ring), sizeof(buffer));
            int recv_len;
#if !BUTTERFI_USB_CONTROL_DEBUG
            uint32_t stored_len;
#endif

            if (len == 0U) {
                uart_irq_rx_disable(dev);
                rx_throttled = true;
                continue;
            }

            recv_len = uart_fifo_read(dev, buffer, len);
            if (recv_len <= 0) {
                continue;
            }

#if BUTTERFI_USB_CONTROL_DEBUG
            usb_diag.rx_bytes += (uint32_t)recv_len;

            for (int index = 0; index < recv_len; index++) {
                parse_byte(buffer[index]);
            }
#else
            stored_len = ring_buf_put(&rx_ring, buffer, recv_len);
            if (stored_len < (uint32_t)recv_len) {
                LOG_WRN("Dropped %d USB bytes", recv_len - (int)stored_len);
            }

            usb_diag.rx_bytes += (uint32_t)stored_len;
#endif
        }

        if (uart_irq_tx_ready(dev)) {
            uint8_t *claim;
            uint32_t claimed;
            int send_len;

            /* Consume via claim/finish so we only remove the bytes the FIFO
             * actually accepted, leaving the rest in place and in order. The
             * old head-read + tail-requeue on a short fifo_fill reordered the
             * byte stream (a frame's tail landing behind later frames), which
             * corrupted telemetry — and made the ISR a second, unsynchronized
             * tx_ring producer. This makes the ISR a pure consumer. */
            claimed = ring_buf_get_claim(&tx_ring, &claim, 64);
            if (claimed == 0U) {
                uart_irq_tx_disable(dev);
                (void)ring_buf_get_finish(&tx_ring, 0);
                continue;
            }

            if (rx_throttled) {
                uart_irq_rx_enable(dev);
                rx_throttled = false;
            }

            send_len = uart_fifo_fill(dev, claim, claimed);
            (void)ring_buf_get_finish(&tx_ring, send_len > 0 ? send_len : 0);
        }
    }
}

static int write_bytes(const uint8_t *data, size_t len)
{
    uint32_t queued_len;

    if (!cdc_dev || !device_is_ready(cdc_dev)) {
        return -ENODEV;
    }

    if (!host_ready_for_tx()) {
        return -EAGAIN;
    }

    /* Serialize concurrent producers so a whole frame is queued atomically
     * (the ring is SPSC; the ISR is the single consumer). Drop the entire
     * frame if it will not fit rather than leaking a truncated one — a dropped
     * frame is recoverable, a half-frame desyncs the host parser. */
    k_mutex_lock(&tx_mutex, K_FOREVER);
    if (ring_buf_space_get(&tx_ring) < len) {
        k_mutex_unlock(&tx_mutex);
        return -ENOSPC;
    }
    queued_len = ring_buf_put(&tx_ring, data, len);
    uart_irq_tx_enable(cdc_dev);
    k_mutex_unlock(&tx_mutex);

    return (queued_len == len) ? 0 : -ENOSPC;
}

static int send_frame(uint8_t frame_type,
                      uint8_t request_id,
                      const uint8_t *payload,
                      uint16_t payload_len,
                      uint8_t flags)
{
    uint8_t frame[BUTTERFI_USB_MAX_FRAME_SIZE];
    size_t frame_len;

    if (payload_len > BUTTERFI_USB_MAX_PAYLOAD) {
        return -EMSGSIZE;
    }

    frame[0] = BUTTERFI_USB_SYNC_1;
    frame[1] = BUTTERFI_USB_SYNC_2;
    frame[2] = BUTTERFI_USB_VERSION;
    frame[3] = frame_type;
    frame[4] = request_id;
    frame[5] = flags;
    frame[6] = payload_len & 0xff;
    frame[7] = (payload_len >> 8) & 0xff;

    if (payload_len > 0 && payload != NULL) {
        memcpy(&frame[8], payload, payload_len);
    }

    frame_len = BUTTERFI_USB_HEADER_SIZE + payload_len + 1;
    frame[frame_len - 1] = frame_checksum(frame, frame_len);

    usb_diag.last_tx_result = write_bytes(frame, frame_len);
    return usb_diag.last_tx_result;
}

void butterfi_usb_get_diag_counters(struct butterfi_usb_diag_counters *diag)
{
    unsigned int key;

    if (diag == NULL) {
        return;
    }

    key = irq_lock();
    *diag = usb_diag;
    irq_unlock(key);
}

void butterfi_usb_update_status(uint8_t device_state,
                                uint8_t link_state,
                                uint8_t active_request_id)
{
    cached_status.device_state = device_state;
    cached_status.link_state = link_state;
    cached_status.active_request_id = active_request_id;

    (void)butterfi_usb_send_status();
}

int butterfi_usb_send_status(void)
{
    uint8_t payload[3] = {
        cached_status.device_state,
        cached_status.link_state,
        cached_status.active_request_id,
    };

    return send_frame(BUTTERFI_USB_FRAME_DEVICE_STATUS, 0, payload, sizeof(payload), 0);
}

int butterfi_usb_send_uplink_accepted(uint8_t request_id)
{
    return send_frame(BUTTERFI_USB_FRAME_DEVICE_UPLINK_ACCEPTED, request_id, NULL, 0, 0);
}

int butterfi_usb_send_response_chunk(uint8_t request_id,
                                     const uint8_t *payload,
                                     uint16_t payload_len)
{
    return send_frame(BUTTERFI_USB_FRAME_DEVICE_RESPONSE_CHUNK,
                      request_id,
                      payload,
                      payload_len,
                      0);
}

int butterfi_usb_send_transfer_complete(uint8_t request_id)
{
    return send_frame(BUTTERFI_USB_FRAME_DEVICE_TRANSFER_COMPLETE, request_id, NULL, 0, 0);
}

int butterfi_usb_send_transfer_error(uint8_t request_id,
                                     uint8_t error_code,
                                     const char *message)
{
    uint8_t payload[1 + BUTTERFI_USB_MAX_PAYLOAD];
    size_t message_len = 0;

    payload[0] = error_code;

    if (message != NULL) {
        message_len = strnlen(message, BUTTERFI_USB_MAX_PAYLOAD - 1);
        memcpy(&payload[1], message, message_len);
    }

    return send_frame(BUTTERFI_USB_FRAME_DEVICE_TRANSFER_ERROR,
                      request_id,
                      payload,
                      1 + message_len,
                      0);
}

int butterfi_usb_send_pong(uint8_t request_id,
                           const uint8_t *payload,
                           uint16_t payload_len)
{
    return send_frame(BUTTERFI_USB_FRAME_DEVICE_PONG, request_id, payload, payload_len, 0);
}

int butterfi_usb_send_debug_text(const char *message)
{
    size_t message_len = 0;

    if (message != NULL) {
        message_len = strnlen(message, BUTTERFI_USB_MAX_PAYLOAD);
    }

    return send_frame(BUTTERFI_USB_FRAME_DEVICE_DEBUG_TEXT,
                      0,
                      (const uint8_t *)message,
                      (uint16_t)message_len,
                      0);
}

int butterfi_usb_send_config_saved(uint8_t request_id, const char *message)
{
    size_t message_len = 0;

    if (message != NULL) {
        message_len = strnlen(message, BUTTERFI_USB_MAX_PAYLOAD);
    }

    return send_frame(BUTTERFI_USB_FRAME_DEVICE_CONFIG_SAVED,
                      request_id,
                      (const uint8_t *)message,
                      (uint16_t)message_len,
                      0);
}

int butterfi_usb_send_mfg_write_ok(uint8_t request_id, const char *message)
{
    size_t message_len = 0;

    if (message != NULL) {
        message_len = strnlen(message, BUTTERFI_USB_MAX_PAYLOAD);
    }

    return send_frame(BUTTERFI_USB_FRAME_DEVICE_MFG_WRITE_OK,
                      request_id,
                      (const uint8_t *)message,
                      (uint16_t)message_len,
                      0);
}

static void maybe_emit_status_on_dtr(void)
{
    uint32_t dtr = 0;
    bool dtr_asserted = false;

    if (!cdc_dev || !device_is_ready(cdc_dev)) {
        return;
    }

    if (uart_line_ctrl_get(cdc_dev, UART_LINE_CTRL_DTR, &dtr) == 0) {
        dtr_asserted = dtr != 0U;
    }

    if (dtr_asserted && !last_dtr_asserted) {
        host_session_active = true;
        (void)uart_line_ctrl_set(cdc_dev, UART_LINE_CTRL_DCD, 1);
        (void)uart_line_ctrl_set(cdc_dev, UART_LINE_CTRL_DSR, 1);
        (void)butterfi_usb_send_status();
    }

    if (!dtr_asserted && last_dtr_asserted) {
        host_session_active = false;
    }

    last_dtr_asserted = dtr_asserted;
}

static void handle_complete_frame(void)
{
    uint16_t payload_len;
    uint8_t checksum;

    payload_len = rx_frame[6] | (rx_frame[7] << 8);
    checksum = frame_checksum(rx_frame, expected_frame_len);

    if (checksum != rx_frame[expected_frame_len - 1]) {
        usb_diag.rx_errors++;
        (void)butterfi_usb_send_transfer_error(rx_frame[4],
                                               BUTTERFI_USB_ERROR_INVALID_HOST_FRAME,
                                               "checksum mismatch");
        parser_reset();
        return;
    }

    host_session_active = true;
    usb_diag.rx_frames++;
    usb_diag.last_frame_type = rx_frame[3];

    if (host_frame_handler != NULL) {
        host_frame_handler(rx_frame[3],
                           rx_frame[4],
                           &rx_frame[8],
                           payload_len,
                           host_frame_context);
    }

    parser_reset();
}

static void parse_byte(uint8_t byte)
{
    if (rx_frame_len == 0 && byte != BUTTERFI_USB_SYNC_1) {
        return;
    }

    if (rx_frame_len == 1 && byte != BUTTERFI_USB_SYNC_2) {
        rx_frame_len = (byte == BUTTERFI_USB_SYNC_1) ? 1 : 0;
        rx_frame[0] = BUTTERFI_USB_SYNC_1;
        expected_frame_len = 0;
        return;
    }

    rx_frame[rx_frame_len++] = byte;

    if (rx_frame_len == BUTTERFI_USB_HEADER_SIZE) {
        uint16_t payload_len = rx_frame[6] | (rx_frame[7] << 8);

        if (rx_frame[2] != BUTTERFI_USB_VERSION || payload_len > BUTTERFI_USB_MAX_PAYLOAD) {
            usb_diag.rx_errors++;
            (void)butterfi_usb_send_transfer_error(rx_frame[4],
                                                   BUTTERFI_USB_ERROR_INVALID_HOST_FRAME,
                                                   "invalid header");
            parser_reset();
            return;
        }

        expected_frame_len = BUTTERFI_USB_HEADER_SIZE + payload_len + 1;
    }

    if (expected_frame_len > 0 && rx_frame_len == expected_frame_len) {
        handle_complete_frame();
    }
}

void butterfi_usb_poll(void)
{
    uint8_t buffer[64];
    uint8_t byte;
    uint32_t recv_len;

    maybe_emit_status_on_dtr();

    if (!cdc_dev || !device_is_ready(cdc_dev)) {
        return;
    }

    while ((recv_len = ring_buf_get(&rx_ring, buffer, sizeof(buffer))) > 0U) {
        for (uint32_t index = 0; index < recv_len; index++) {
            parse_byte(buffer[index]);
        }
    }

    /* Fallback for CDC ACM backends where the UART IRQ callback path is unreliable. */
    while (uart_poll_in(cdc_dev, &byte) == 0) {
        usb_diag.rx_bytes++;
        parse_byte(byte);
    }

    if (rx_throttled && ring_buf_space_get(&rx_ring) > 0U) {
        rx_throttled = false;
        uart_irq_rx_enable(cdc_dev);
    }
}

int butterfi_usb_init(butterfi_usb_host_frame_handler_t handler, void *context)
{
    int ret;

    host_frame_handler = handler;
    host_frame_context = context;
    parser_reset();
    last_dtr_asserted = false;
    host_session_active = false;
    rx_throttled = false;
    ring_buf_init(&rx_ring, sizeof(rx_ring_buffer), rx_ring_buffer);
    ring_buf_init(&tx_ring, sizeof(tx_ring_buffer), tx_ring_buffer);

    if (!device_is_ready(cdc_dev)) {
        LOG_ERR("CDC ACM device not ready");
        return -ENODEV;
    }

    ret = usb_enable(NULL);
    if (ret < 0) {
        LOG_ERR("USB enable failed: %d", ret);
        return ret;
    }

    uart_irq_callback_set(cdc_dev, cdc_interrupt_handler);
    uart_irq_rx_enable(cdc_dev);

    LOG_INF("USB CDC-ACM ready");
    return 0;
}
```

## src/butterfi_usb.h
```c
/* Shared ButterFi USB framing used by the browser runtime console. */

#ifndef BUTTERFI_USB_H
#define BUTTERFI_USB_H

#include <stddef.h>
#include <stdint.h>

enum butterfi_usb_frame_type {
	BUTTERFI_USB_FRAME_HOST_QUERY_SUBMIT = 0x01,
	BUTTERFI_USB_FRAME_HOST_RESEND_REQUEST = 0x02,
	BUTTERFI_USB_FRAME_HOST_CANCEL_REQUEST = 0x03,
	BUTTERFI_USB_FRAME_HOST_PING = 0x04,
	BUTTERFI_USB_FRAME_HOST_STATUS_REQUEST = 0x05,
	BUTTERFI_USB_FRAME_HOST_CONFIG_SAVE = 0x06,
	BUTTERFI_USB_FRAME_HOST_MFG_WRITE = 0x07,
	BUTTERFI_USB_FRAME_DEVICE_STATUS = 0x81,
	BUTTERFI_USB_FRAME_DEVICE_UPLINK_ACCEPTED = 0x82,
	BUTTERFI_USB_FRAME_DEVICE_RESPONSE_CHUNK = 0x83,
	BUTTERFI_USB_FRAME_DEVICE_TRANSFER_COMPLETE = 0x84,
	BUTTERFI_USB_FRAME_DEVICE_TRANSFER_ERROR = 0x85,
	BUTTERFI_USB_FRAME_DEVICE_PONG = 0x86,
	BUTTERFI_USB_FRAME_DEVICE_DEBUG_TEXT = 0x87,
	BUTTERFI_USB_FRAME_DEVICE_CONFIG_SAVED = 0x88,
	BUTTERFI_USB_FRAME_DEVICE_MFG_WRITE_OK = 0x89,
};

enum butterfi_usb_device_state {
	BUTTERFI_USB_DEVICE_STATE_IDLE = 0,
	BUTTERFI_USB_DEVICE_STATE_SERIAL_READY = 1,
	BUTTERFI_USB_DEVICE_STATE_SIDEWALK_STARTING = 2,
	BUTTERFI_USB_DEVICE_STATE_SIDEWALK_READY = 3,
	BUTTERFI_USB_DEVICE_STATE_BUSY = 4,
	BUTTERFI_USB_DEVICE_STATE_ERROR = 5,
	BUTTERFI_USB_DEVICE_STATE_SIDEWALK_NOT_REGISTERED = 6,
};

enum butterfi_usb_link_state {
	BUTTERFI_USB_LINK_UNKNOWN = 0,
	BUTTERFI_USB_LINK_BLE = 1,
	BUTTERFI_USB_LINK_FSK = 2,
	BUTTERFI_USB_LINK_LORA = 3,
};

enum butterfi_usb_error_code {
	BUTTERFI_USB_ERROR_INVALID_HOST_FRAME = 0x01,
	BUTTERFI_USB_ERROR_DEVICE_BUSY = 0x02,
	BUTTERFI_USB_ERROR_SIDEWALK_UNAVAILABLE = 0x03,
	BUTTERFI_USB_ERROR_CLOUD_FETCH_FAILED = 0x04,
	BUTTERFI_USB_ERROR_TRANSFER_TIMED_OUT = 0x05,
	BUTTERFI_USB_ERROR_PROTOCOL_MISMATCH = 0x06,
	BUTTERFI_USB_ERROR_CONFIG_SAVE_FAILED = 0x07,
	BUTTERFI_USB_ERROR_MFG_WRITE_FAILED = 0x08,
};

typedef void (*butterfi_usb_host_frame_handler_t)(uint8_t frame_type,
												  uint8_t request_id,
												  const uint8_t *payload,
												  uint16_t payload_len,
												  void *context);

struct butterfi_usb_diag_counters {
	uint32_t rx_bytes;
	uint32_t rx_frames;
	uint32_t rx_errors;
	int32_t last_tx_result;
	uint8_t last_frame_type;
};

int  butterfi_usb_init(butterfi_usb_host_frame_handler_t handler, void *context);
void butterfi_usb_poll(void);
void butterfi_usb_get_diag_counters(struct butterfi_usb_diag_counters *diag);
void butterfi_usb_update_status(uint8_t device_state,
								uint8_t link_state,
								uint8_t active_request_id);
int  butterfi_usb_send_status(void);
int  butterfi_usb_send_uplink_accepted(uint8_t request_id);
int  butterfi_usb_send_response_chunk(uint8_t request_id,
									  const uint8_t *payload,
									  uint16_t payload_len);
int  butterfi_usb_send_transfer_complete(uint8_t request_id);
int  butterfi_usb_send_transfer_error(uint8_t request_id,
									  uint8_t error_code,
									  const char *message);
int  butterfi_usb_send_pong(uint8_t request_id,
							const uint8_t *payload,
							uint16_t payload_len);
int  butterfi_usb_send_debug_text(const char *message);
int  butterfi_usb_send_config_saved(uint8_t request_id, const char *message);
int  butterfi_usb_send_mfg_write_ok(uint8_t request_id, const char *message);

#endif /* BUTTERFI_USB_H */
```
